/* MenuInterpreter
   (Parts of this file was already part of my eariler Gamebox project)
   (c) 2004 - 2016, 2020  by Malte Marwedel
   m DOT talk AT marwedels DOT de
   www.marwedels.de/malte
   menudesigner.sourceforge.net

   This Source Code Form is subject to the terms of the
   Mozilla Public License, v. 2.0.
   If a copy of the MPL was not distributed with this file,
   You can obtain one at https://mozilla.org/MPL/2.0/.
*/
//SPDX-License-Identifier: MPL-2.0

/* This function writes single chars to the display.
Currently 5x5, 7x5 and 8x15 pixel fonts are supported.
Every char is encoded as 5 byte (5x5 and 5x7 fonts).
For the 8x15 font, its 16 bytes.

The 5x7 font is based of a font from:
http://overcode.yak.net/12

Date of last changes:
  2020-04-12: Replace 8x15 font by own one. Reported height is now always 15, even with underline.
               License change from GPLv2 or later to MPL-2.0
  2020-01-25: Change dataypes to uint*_t variants
  2016-06-18: Completely rework renderer, adding utf-8 support, including 8x15 font
  2015-12-10: Add tab for 5x5 font, same size as digits of font 13 and 14
  2014-04-27: Add support for 5x5 font (font 13, 14, 15), add degree symbol
  2010-05-15: Prevent overflow of chars to the left side
  2010-02-10: Add german umlauts, fix & and ~ sign, translate some comments
  2009-09-10: Use SCREENPOS datatype to support 16 bit screen resolution
  2009-05-24: Changed in black/white char renderer
  2005-07-19: Character "P" was wrong
  2005-07-23: draw_tinynumber(), draw_tinydigit() added
*/

#include "menu-interpreter.h"

//the following file might define MENU_USE_UTF8
#include "menu-interpreter-config.h"

#include <string.h>

// === defines, adapt to your needs ==========================

//enable if you dont want to switch to utf-8
//#define MENU_ENABLE_SPECIAL_CHARS

//make pc compatible
#ifndef AVR_BUILD

#define PROGMEM
#define COPYFUNCTION memcpy
#define COPY4BYTES(X) *(X)

#else

#include <avr/pgmspace.h>

#define COPYFUNCTION memcpy_P
//you might want to use pgm_read_dword on small (<= 64KB flash) AVRs
#define COPY4BYTES pgm_read_dword_far

#endif


//#define DEBUG

#ifdef DEBUG
#include "stdio.h"
//use printf for debug messages
#define MENU_DEBUGMSG printf

#else
//ignore debug messages
#define MENU_DEBUGMSG(...)

#endif


// === end of defines which should be modified by the user ====

#ifndef UNREFERENCED_PARAMETER
#define UNREFERENCED_PARAMETER(P) (void)(P)
#endif

//for backward compatibility, warn users
#if defined(ENABLE_GERMAN_UMLAUTS)
#error "Update to UTF-8"
#endif

#if defined(MENU_ENABLE_SPECIAL_CHARS)
#warning "MENU_ENABLE_SPECIAL_CHARS is deprecated and might be removed in future versions, use UTF-8 instead"
#define MENU_USE_UTF8
#endif

#define MENU_TEXT_5X7_BYTES 5
#define MENU_TEXT_5X5_BYTES 5
#define MENU_TEXT_8X15_BYTES 16
#define MENU_TEXT_5X7_WIDTH 5
#define MENU_TEXT_5X5_WIDTH 5
#define MENU_TEXT_8X15_WIDTH 8


#if defined(MENU_USE_FONT_0) || defined(MENU_USE_FONT_1) || defined(MENU_USE_FONT_2) || defined(MENU_USE_FONT_3)
#define MENU_TEXT_ENABLE_5X7
#define MENU_TEXT_5X7_CNT 1
#else
#define MENU_TEXT_5X7_CNT 0
#endif

#if defined(MENU_USE_FONT_4) || defined(MENU_USE_FONT_5) || defined(MENU_USE_FONT_6) || defined(MENU_USE_FONT_7)
#define MENU_TEXT_ENABLE_8X15

#define MENU_TEXT_8X15_CNT 1
#else
#define MENU_TEXT_8X15_CNT 0
#endif

#if defined(MENU_USE_FONT_12) || defined(MENU_USE_FONT_13) || defined(MENU_USE_FONT_14) || defined(MENU_USE_FONT_15)
#define MENU_TEXT_ENABLE_5X5
#define MENU_TEXT_5X5_CNT 1
#else
#define MENU_TEXT_5X5_CNT 0
#endif

//this define gives the different types of fonts used, to optimize code later
#define MENU_TEXT_FONT_CLASSES (MENU_TEXT_5X7_CNT + MENU_TEXT_8X15_CNT + MENU_TEXT_5X5_CNT)

//see extra directory for a 8x15 renderer which uses font numbers 3...6
#if defined(MENU_USE_FONT_8) || defined(MENU_USE_FONT_9) || \
    defined(MENU_USE_FONT_10) || defined(MENU_USE_FONT_11) || \
    (MENU_USE_FONT_MAX > 15)

#error "Menu uses a font for which no renderer is implemented right now"

#endif

// some macros to optimize the source code without let him look way too messy

#ifdef MENU_TEXT_ENABLE_5X5
	#if (MENU_TEXT_FONT_CLASSES > 1)
		#define MENU_CHECK_FONT_5X5 ((font >= 12) && (font <= 15))
	#else
		#define MENU_CHECK_FONT_5X5 (1)
	#endif
#else
	#define MENU_CHECK_FONT_5X5 (0)
#endif

#ifdef MENU_TEXT_ENABLE_5X7
	#if (MENU_TEXT_FONT_CLASSES > 1)
		#define MENU_CHECK_FONT_5X7 (font <= 3)
	#else
		#define MENU_CHECK_FONT_5X7 (1)
	#endif
#else
	#define MENU_CHECK_FONT_5X7 (0)
#endif

#ifdef MENU_TEXT_ENABLE_8X15
	#if (MENU_TEXT_FONT_CLASSES > 1)
		#define MENU_CHECK_FONT_8X15 ((font >= 4) && (font <= 8))
	#else
		#define MENU_CHECK_FONT_8X15 (1)
	#endif
#else
	#define MENU_CHECK_FONT_8X15 (0)
#endif

#if defined(MENU_TEXT_ENABLE_5X7) || defined(MENU_TEXT_ENABLE_8X15)
//only valid for font 2, 3, 6, 7
	#define MENU_CHECK_FONT_UNDERLINED ((font & 0xFA) == 0x02)
#else
	#define MENU_CHECK_FONT_UNDERLINED (0)
#endif

//note all utf8CharXxY_t must have the bitmap right after the utf8Code. Otherwise optimizations in menu_get_pBitmap wont work as expected
typedef struct {
	uint32_t utf8Code; //should be 32bit datatype
	uint8_t bitmap[MENU_TEXT_5X5_BYTES];
} utf8Char5x5_t;

typedef struct {
	uint32_t utf8Code; //should be 32bit datatype
	uint8_t bitmap[MENU_TEXT_8X15_BYTES];
} utf8Char8x15_t;

typedef utf8Char5x5_t utf8Char5x7_t;

//ASCII characters defined for every font
#define MENU_CHARACTERS 95
#define MENU_CHARACTER_TABLE_OFFSET 32

#define WEAK __attribute__((weak))

/*
BUG:
  Defining extern weak global variables here and replacing them by actual
  arrays on demand:
  works on Linux with gcc 4.9.2 (64Bit)
  works on Windows Vista with with Cygwin and gcc 5.4.0 (32bit)
  fails on Windows 7 with Cygwin and gcc 5.4.0 (64bit) for the characters_5x7_utf8 array
     (other program data found under the array address) but works for the characters_5x7 array...
  So we remove the defines here if the real array exists, otherwise all testcase for special
     chars will fail under the one platform...
*/

#ifndef MENU_TEXT_ENABLE_5X5
extern const uint8_t        WEAK characters_5x5[MENU_CHARACTERS * MENU_TEXT_5X5_BYTES];
extern const utf8Char5x5_t  WEAK characters_5x5_utf8[];
#endif

#ifndef MENU_TEXT_ENABLE_5X7
extern const uint8_t        WEAK characters_5x7[MENU_CHARACTERS * MENU_TEXT_5X7_BYTES];
extern const utf8Char5x7_t  WEAK characters_5x7_utf8[];
#endif


#ifndef MENU_TEXT_ENABLE_8X15
extern const uint8_t        WEAK characters_8x15[MENU_CHARACTERS * MENU_TEXT_8X15_BYTES];
extern const utf8Char8x15_t WEAK characters_8x15_utf8[];
#endif



#ifdef MENU_TEXT_ENABLE_5X7

const uint8_t characters_5x7[MENU_CHARACTERS * MENU_TEXT_5X7_BYTES] PROGMEM = {
0x00,0x00,0x00,0x00,0x00, //Space
0x00,0x00,0x5F,0x00,0x00, //Exclamation mark
0x00,0x03,0x00,0x03,0x00,
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0x08,0x04,0x08,0x10,0x08 //~
};
#ifdef MENU_USE_UTF8
#define MENU_TEXT_5X7_UTF8CHARS 8
const utf8Char5x7_t characters_5x7_utf8[MENU_TEXT_5X7_UTF8CHARS] PROGMEM = {
{0xC2B0, {0x00, 0x02, 0x05, 0x02, 0x00}}, // °
{0xC384, {0x79, 0x14, 0x12, 0x14, 0x79}}, // Ä
{0xC396, {0x39, 0x44, 0x44, 0x44, 0x39}}, // Ö
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{0xC3BC, {0x3D, 0x40, 0x40, 0x40, 0x3D}} // ü
};

#else

#define MENU_TEXT_5X7_UTF8CHARS 0

#endif
#else

#define MENU_TEXT_5X7_UTF8CHARS 0

#endif

#ifdef MENU_TEXT_ENABLE_5X5
const uint8_t characters_5x5[MENU_CHARACTERS * MENU_TEXT_5X5_BYTES] PROGMEM = {
0x00, 0x00, 0x00, 0x00, 0x00, //
0x00, 0x00, 0x17, 0x00, 0x00, // !
0x00, 0x03, 0x00, 0x03, 0x00, // "
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0x04, 0x02, 0x04, 0x08, 0x04 // ~
};
#ifdef MENU_USE_UTF8
#define MENU_TEXT_5X5_UTF8CHARS 10
const utf8Char5x5_t characters_5x5_utf8[MENU_TEXT_5X5_UTF8CHARS] PROGMEM = {
{0xC2B0, {0x00, 0x02, 0x05, 0x02, 0x00}}, // °
{0xC2B5, {0x1E, 0x08, 0x08, 0x06, 0x00}}, // µ
{0xC384, {0x19, 0x0C, 0x0A, 0x0C, 0x19}}, // Ä
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{0xCEA9, {0x16, 0x19, 0x01, 0x19, 0x16}} // Ω
};
#else

#define MENU_TEXT_5X5_UTF8CHARS 0

#endif
#else

#define MENU_TEXT_5X5_UTF8CHARS 0

#endif

#ifdef MENU_TEXT_ENABLE_8X15

//source for the font: extra/font-8x15-malte-marked.png
const uint8_t characters_8x15[MENU_CHARACTERS * MENU_TEXT_8X15_BYTES] PROGMEM = {
0x00, 0x00, 0x00, 0x00, 0x00, 0x00, 0x00, 0x00, 0x00, 0x00, 0x00, 0x00, 0x00, 0x00, 0x00, 0x00, //
0x00, 0x00, 0x00, 0xFE, 0x00, 0x00, 0x00, 0x00, 0x00, 0x00, 0x00, 0x0B, 0x00, 0x00, 0x00, 0x00, // !
0x00, 0x00, 0x07, 0x00, 0x00, 0x07, 0x00, 0x00, 0x00, 0x00, 0x00, 0x00, 0x00, 0x00, 0x00, 0x00, // "
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0x40, 0x20, 0x20, 0x40, 0x80, 0x80, 0x40, 0x00, 0x00, 0x00, 0x00, 0x00, 0x00, 0x00, 0x00, 0x00 // ~
};
#ifdef MENU_USE_UTF8
#define MENU_TEXT_8X15_UTF8CHARS 10
const utf8Char8x15_t characters_8x15_utf8[MENU_TEXT_8X15_UTF8CHARS] PROGMEM = {
{0xC2B0, {0x00, 0x06, 0x09, 0x09, 0x06, 0x00, 0x00, 0x00, 0x00, 0x00, 0x00, 0x00, 0x00, 0x00, 0x00, 0x00}}, // °
{0xC2B5, {0xE0, 0x00, 0x00, 0x00, 0x00, 0xE0, 0x00, 0x00, 0x7F, 0x08, 0x08, 0x08, 0x04, 0x03, 0x00, 0x00}}, // µ
{0xC384, {0xF1, 0x48, 0x44, 0x42, 0x44, 0x48, 0xF1, 0x00, 0x0F, 0x00, 0x00, 0x00, 0x00, 0x00, 0x0F, 0x00}}, // Ä
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{0xCEA9, {0xF8, 0x04, 0x02, 0x02, 0x02, 0x04, 0xF8, 0x00, 0x0C, 0x09, 0x0E, 0x00, 0x0E, 0x09, 0x0C, 0x00}} // Ω
};
#else
#define MENU_TEXT_8X15_UTF8CHARS 0
#endif


#else

#define MENU_TEXT_8X15_UTF8CHARS 0

#endif

#if defined(MENU_USE_UTF8) && !defined(MENU_SCREEN_7SEGMENT) && !defined(MENU_SCREEN_HD44780)
  uint8_t g_menu_utf8_state;
  uint32_t g_menu_utf8_char;


static const uint8_t * menu_get_pBitmap(uint32_t cdrawx, uint8_t font) {
	uint8_t lowerlim, upperlim, hardlim, idx; //needs to be an uint16_t or uint32_t if there are more than 255 utf-8 chars
	uint32_t utf8Code;
	const uint32_t * utf8CodeAddr;
	uint8_t bytesToData = 0;
#if (MENU_TEXT_FONT_CLASSES < 2)
	UNREFERENCED_PARAMETER(font);
#endif
	hardlim = 0;
	if (MENU_CHECK_FONT_5X5) {
		hardlim = MENU_TEXT_5X5_UTF8CHARS;
		bytesToData = (char *)(&(characters_5x5_utf8[0].bitmap)) - (char *)(&(characters_5x5_utf8[0].utf8Code)); //compiler evaluates this to a single constant
	}
	if (MENU_CHECK_FONT_5X7) {
		hardlim = MENU_TEXT_5X7_UTF8CHARS;
		bytesToData = (char *)(&(characters_5x7_utf8[0].bitmap)) - (char *)(&(characters_5x7_utf8[0].utf8Code)); //compiler evaluates this to a single constant
	}
	if (MENU_CHECK_FONT_8X15) {
		hardlim = MENU_TEXT_8X15_UTF8CHARS;
		bytesToData = (char *)(&(characters_8x15_utf8[0].bitmap)) - (char *)(&(characters_8x15_utf8[0].utf8Code)); //compiler evaluates this to a single constant
	}
	lowerlim = 0;
	upperlim = hardlim;
	utf8CodeAddr = NULL;
	while (upperlim > lowerlim) {
		idx = (upperlim - lowerlim) / 2 + lowerlim;
		if (MENU_CHECK_FONT_5X5) {
			utf8CodeAddr = &(characters_5x5_utf8[idx].utf8Code);
		}
		if (MENU_CHECK_FONT_5X7) {
			utf8CodeAddr = &(characters_5x7_utf8[idx].utf8Code);
		}
		if (MENU_CHECK_FONT_8X15) {
			utf8CodeAddr = &(characters_8x15_utf8[idx].utf8Code);
		}
		utf8Code = COPY4BYTES(utf8CodeAddr);
		//printf("idx= %i lower %i, upper %i , cmp = %lx<>%lx\n", idx, lowerlim, upperlim, utf8Code, cdrawx);
		if (idx >= hardlim)
			break;
		if (utf8Code == cdrawx)
			return ((const uint8_t *)utf8CodeAddr + bytesToData); //this only works because the struct has the bitmap after the utf8 code
		if (utf8Code < cdrawx) {
			if (lowerlim == idx)
				break;
			lowerlim = idx;
		} else {
			if (upperlim == idx)
				break;
			upperlim = idx;
		}
		//printf("  idx= %i lower %i, upper %i , cmp = %lx<>%lx\n", idx, lowerlim, upperlim, data[idx].utf8Code, cdrawx);
	}
	return NULL; //not found
}
#endif


unsigned char menu_font_heigth(unsigned char font) {
	if (MENU_CHECK_FONT_5X5) {
		return 5;
	}
	if (MENU_CHECK_FONT_5X7) {
		if (font < 2)
			return 7; //normal 5x7 font
		return 8; //with underline
	}
	if (MENU_CHECK_FONT_8X15) {
		return 15;
	}
	return 0; //might be unreachable
}

#if !defined(MENU_SCREEN_7SEGMENT) && !defined(MENU_SCREEN_HD44780)

uint8_t menu_char_draw(SCREENPOS posx, SCREENPOS posy, uint8_t font, char c, uint8_t transparency) {
	uint8_t ix, iy, charwidth, patternbyte, patternbit;
#if defined(MENU_TEXT_ENABLE_8X15)
	uint8_t copyedbytes[MENU_TEXT_8X15_BYTES];
#else
	uint8_t copyedbytes[MENU_TEXT_5X7_BYTES];
#endif
	SCREENPOS tempx, tempy;
	uint8_t byte_eq_count, nun;
	uint8_t cdraw = (uint8_t)c;
	/* level of char shrinking:
	0: Fixed with
	1: Width defined by character within array, only empty colums are removed.
	2: three or four same colums -> remove one. five same colums -> remove two.
	3: two -> remove one. three or four -> remove two. five -> remove three
	*/
	uint8_t shrink = 0;
	uint8_t fontheight;
	uint8_t underlineoffset = 0;
//------------------- UTF-8 decoding ----------------------
#if defined(MENU_USE_UTF8)
	uint32_t cdrawx;
	//catch utf8 chars
#ifndef MENU_ENABLE_SPECIAL_CHARS
	if (cdraw >= (MENU_CHARACTERS + MENU_CHARACTER_TABLE_OFFSET)) { //its something for utf-8
		if (!g_menu_utf8_state)  {
			//a new char begins
			g_menu_utf8_char = cdraw;
			if ((cdraw & 0xE0) == 0xC0) {
				g_menu_utf8_state = 1;
			}
			if ((cdraw & 0xF0) == 0xE0) {
				g_menu_utf8_state = 2;
			}
			if ((cdraw & 0xF8) == 0xF0) {
				g_menu_utf8_state = 3;
			}
			return -1; //symbol not complete, 255 = -1 do not go one pixel to the right
		} else {
			g_menu_utf8_char <<= 8;
			g_menu_utf8_char |= cdraw;
			g_menu_utf8_state--;
			if (g_menu_utf8_state) {
				return 0; //symbol not complete
			}
			cdrawx = g_menu_utf8_char; //symbol complete
		}
	} else {
		g_menu_utf8_state = 0; //reset state
		cdrawx = cdraw;
	}
#else
	//for backward compatibility only
	cdrawx = cdraw;
	if (cdraw == 196) cdrawx = 0xC384; //Ä
	if (cdraw == 214) cdrawx = 0xC396; //Ö
	if (cdraw == 220) cdrawx = 0xC39C; //Ü
	if (cdraw == 228) cdrawx = 0xC3A4; //ä
	if (cdraw == 246) cdrawx = 0xC3B6; //ö
	if (cdraw == 252) cdrawx = 0xC3BC; //ü
	if (cdraw == 223) cdrawx = 0xC39F; //ß
	if (cdraw == 0xB0) cdrawx = 0xC2B0; //°
#endif
#else
	uint8_t cdrawx = cdraw;
#endif
//--------------- special handling... ------------------------------------------
	if (MENU_CHECK_FONT_5X5) {
		if (cdraw == 9) { //its a tab, make same width as digits -> easy blinking (safe to use cdraw instead of cdrawx here)
			return 3;
		}
	}
//--------------- determine data source ----------------------------------------
	const uint8_t * bmpsource = NULL;
	uint8_t bmpsize = 0;
	uint8_t bmpwidth = 0;
	if (MENU_CHECK_FONT_5X5) {
		bmpsize = MENU_TEXT_5X5_BYTES;
		bmpwidth = MENU_TEXT_5X5_WIDTH;
	}
	if (MENU_CHECK_FONT_5X7) {
		bmpsize = MENU_TEXT_5X7_BYTES;
		bmpwidth = MENU_TEXT_5X7_WIDTH;
	}
	if (MENU_CHECK_FONT_8X15) {
		bmpsize = MENU_TEXT_8X15_BYTES;
		bmpwidth = MENU_TEXT_8X15_WIDTH;
	}
	if ((cdrawx < (MENU_CHARACTERS + MENU_CHARACTER_TABLE_OFFSET)) &&
	    (cdrawx >= MENU_CHARACTER_TABLE_OFFSET)) { //simple ASCII case, cdraw = cdrawx
		cdraw -= MENU_CHARACTER_TABLE_OFFSET;
		if (MENU_CHECK_FONT_5X5) {
			bmpsource = &(characters_5x5[MENU_TEXT_5X5_BYTES * cdraw]);
		}
		if (MENU_CHECK_FONT_5X7) {
			bmpsource = &(characters_5x7[MENU_TEXT_5X7_BYTES * cdraw]);
		}
		if (MENU_CHECK_FONT_8X15) {
			bmpsource = &(characters_8x15[MENU_TEXT_8X15_BYTES * cdraw]);
		}
	}
#if defined(MENU_USE_UTF8)
	else {
		bmpsource = menu_get_pBitmap(cdrawx, font);
	}
#endif
	if (!bmpsource) {
		MENU_DEBUGMSG("Error: no bitmap for char 0x%lx\r\n", (unsigned long)cdrawx);
		return 0;
	}
//--------------- copy bitmask to buffer ---------------------------------------
	COPYFUNCTION(copyedbytes, bmpsource, bmpsize);
//------------- prepare drawing by evaluating actual size of the character -----
	if (MENU_CHECK_FONT_5X5) {
		shrink = font - 12;
	}
	if (MENU_CHECK_FONT_5X7) {
		if ((font == 0) || (font == 2)) {
			shrink = 2;
		}
	}
	if (MENU_CHECK_FONT_8X15) {
		if ((font == 4) || (font == 6)) {
			shrink = 2;
		}
	}
	charwidth = 0;
	//automated shortening of chars
	if (shrink > 1) {
		byte_eq_count = 0;
		for (nun = 0; nun < bmpwidth-1; nun++) {
			byte_eq_count++;
			if (copyedbytes[nun] != copyedbytes[nun+1]) {
				byte_eq_count = 0;
			}
			if (MENU_CHECK_FONT_5X5) {
				if ((byte_eq_count == 1) && (shrink == 3)) {
					copyedbytes[nun] = 0;
				}
				if ((nun > 0) && (font == 14) && (byte_eq_count == 1) &&
			  	  (copyedbytes[nun-1]) && (cdraw >= ('0' - MENU_CHARACTER_TABLE_OFFSET)) &&
				    (cdraw <= ('9' - MENU_CHARACTER_TABLE_OFFSET))) {
					//shortens numbers to 3 pixel witdh, but no less. Relevant for 3 and 7.
					copyedbytes[nun] = 0;
				}
			}
			if (MENU_CHECK_FONT_8X15) {
				if (copyedbytes[nun + MENU_TEXT_8X15_WIDTH] != copyedbytes[nun + MENU_TEXT_8X15_WIDTH + 1]) {
					byte_eq_count = 0;
				}
			}
			if (byte_eq_count == 2) {
				//remove one byte, if it repeated three times
				copyedbytes[nun] = 0;
				if (MENU_CHECK_FONT_8X15) {
					copyedbytes[nun + MENU_TEXT_8X15_WIDTH] = 0;
				}
			}
			if (byte_eq_count == 4) {
				//if there are 5 bytes equal, we remove a second one
				copyedbytes[nun] = 0;
				if (MENU_CHECK_FONT_8X15) {
					copyedbytes[nun + MENU_TEXT_8X15_WIDTH] = 0;
				}
			}
		} //end of loop
	} //end if shrink != 0
	fontheight = menu_font_heigth(font);
	if (MENU_CHECK_FONT_UNDERLINED) { //only valid for font 2, 3, 6, 7
		if ((font == 6) || (font == 7))
		{
			underlineoffset = fontheight - 2;
		} else { //font 2 and 3
			fontheight--; //no underline here
			underlineoffset = fontheight;
		}
	}
//------------------- actually draw --------------------------------------------
	for (ix = 0; ix < bmpwidth; ix++) {
		tempx = posx+charwidth;
		if (tempx < posx+charwidth) {
			break; //prevent overflow to the left side of the screen
		}
		patternbyte = copyedbytes[ix];
		patternbit = 1;
		for (iy = 0; iy < fontheight; iy++) {
			if (MENU_CHECK_FONT_8X15) {
				if (!patternbit) {
					patternbit = 1;
					patternbyte = copyedbytes[ix + bmpwidth];
				}
			}
			tempy = posy+iy;
			if ((patternbyte & patternbit) != 0) {
				menu_screen_set(tempx, tempy, MENU_COLOR_TEXT);
			} else if (transparency == 0) {
				menu_screen_set(tempx, tempy, MENU_COLOR_BACKGROUND);
			}
			patternbit <<= 1;
		}       //end: inner loop
		if (MENU_CHECK_FONT_UNDERLINED) { //only valid for font 2, 3, 6, 7
			menu_screen_set(tempx, posy + underlineoffset, MENU_COLOR_TEXT);//underline fonts
		}
		if ((copyedbytes[ix] != 0) || (shrink == 0) ||
				((MENU_CHECK_FONT_8X15) && (copyedbytes[ix + MENU_TEXT_8X15_WIDTH] != 0)) ||
				((MENU_CHECK_FONT_8X15) && (cdrawx == ' ') && (charwidth < 2))) {
			charwidth++;
		}       //end: charwidth++
	}         //end: outer loop
#ifdef MENU_USE_FONT_14
	if ((font == 14) && (cdrawx == '1')) {
		charwidth = 3;
	}
#endif
	if (MENU_CHECK_FONT_UNDERLINED) { //only valid for font 2, 3, 6, 7
		menu_screen_set(posx + charwidth, posy + underlineoffset, MENU_COLOR_TEXT); //underline empty part between chars (this is not perfect on word ending)
	}
	return charwidth++;
}          //end: function

#endif
